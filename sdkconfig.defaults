## sdkconfig.defaults
```kconfig
# SurvivaBoard uses the ESP32-S3-WROOM-1-N16R8: 16 MB flash, 8 MB PSRAM.
CONFIG_ESPTOOLPY_FLASHSIZE_16MB=y
CONFIG_ESPTOOLPY_FLASHSIZE="16MB"

# Keep UART0 free for the MAX-M10S connection and use USB Serial/JTAG for logs.
# CONFIG_ESP_CONSOLE_UART_DEFAULT is not set
CONFIG_ESP_CONSOLE_USB_SERIAL_JTAG=y
CONFIG_ESP_CONSOLE_SECONDARY_NONE=y

# Reserve enough room for two OTA images and a FAT-formatted data partition.
CONFIG_PARTITION_TABLE_CUSTOM=y
CONFIG_PARTITION_TABLE_CUSTOM_FILENAME="partitions.csv"
CONFIG_PARTITION_TABLE_FILENAME="partitions.csv"
```
